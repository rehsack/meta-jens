## conf/distro/updatable.conf
```bitbake
PACKAGE_CLASSES ?= "package_ipk"
USER_CLASSES ?= "buildstats image-mklibs image-prelink"

# Additional license directories.
# LICENSE_PATH += "${LAYERDIR}/custom-licenses"

# ENABLE_BINARY_LOCALE_GENERATION controls the generation of binary locale
# packages at build time using qemu-native. Disabling it (by setting it to 0)
# will save some build time at the expense of breaking i18n on devices with
# less than 128MB RAM.
ENABLE_BINARY_LOCALE_GENERATION = "1"

# eglibc configurability is used to reduce minimal image's size.
# the all supported eglibc options are listed in DISTRO_FEATURES_LIBC
# and disabled by default. Uncomment and copy the DISTRO_FEATURES_LIBC
# and DISTRO_FEATURES definitions to local.conf to enable the options.
DISTRO_FEATURES_LIBC = "ipv4 ipv6 libc-backtrace libc-big-macros libc-bsd libc-cxx-tests libc-catgets libc-charsets libc-crypt \
               libc-crypt-ufc libc-db-aliases libc-envz libc-fcvt libc-fmtmsg libc-fstab libc-ftraverse \
               libc-getlogin libc-idn libc-inet libc-inet-anl libc-libm libc-locales libc-locale-code \
               libc-memusage libc-nis libc-nsswitch libc-rcmd libc-rtld-debug libc-spawn libc-streams libc-sunrpc \
               libc-utmp libc-utmpx libc-wordexp libc-posix-clang-wchar libc-posix-regexp libc-posix-regexp-glibc \
               libc-posix-wchar-io"

# aa-dj af-za ak-gh an-es anp-in ar-ae ar-bh ar-dz ar-eg ar-in ar-iq ar-jo ar-kw ar-lb ar-ly ar-ma ar-om ar-qa ar-sa ar-sd ar-ss ar-sy ar-tn ar-ye as-in ast-es ayc-pe az-az be-by bem-zm ber-dz ber-ma bg-bg bho-in bn-in bo-cn bo-in br-fr brx-in bs-ba ca-ad ca-es ca-fr ca-it cmn-tw crh-ua cs-cz csb-pl cv-ru cy-gb da-dk de-at de-be de-ch de-de de-lu doi-in dv-mv dz-bt el-cy el-gr en-ag en-au en-bw en-ca en-dk en-gb en-hk en-ie en-in en-ng en-nz en-ph en-sg en-us en-za en-zm en-zw es-ar es-bo es-cl es-co es-cr es-cu es-do es-ec es-es es-gt es-hn es-mx es-ni es-pa es-pe es-pr es-py es-sv es-us es-uy es-ve et-ee eu-es fa-ir ff-sn fi-fi fil-ph fo-fo fr-be fr-ca fr-ch fr-fr fr-lu fur-it fy-de fy-nl ga-ie gd-gb gl-es gu-in gv-gb ha-ng hak-tw he-il hi-in hne-in hr-hr hsb-de ht-ht hu-hu hy-am ia-fr id-id ig-ng ik-ca is-is it-ch it-it iu-ca iw-il ja-jp ka-ge kk-kz kl-gl km-kh kn-in ko-kr kok-in ks-in ku-tr kw-gb ky-kg lb-lu lg-ug li-be li-nl lij-it lo-la lt-lt lv-lv lzh-tw mag-in mai-in mg-mg mhr-ru mi-nz mk-mk ml-in mni-in mr-in ms-my mt-mt my-mm nan-tw nb-no nds-de nds-nl ne-np nhn-mx niu-nu niu-nz nl-aw nl-be nl-nl nn-no nr-za nso-za oc-fr om-ke or-in os-ru pa-in pa-pk pap-an pap-aw pap-cw pl-pl ps-af pt-br pt-pt quz-pe ro-ro ru-ru ru-ua rw-rw sa-in sat-in sc-it sd-in se-no shs-ca si-lk sk-sk sl-si so-dj so-ke so-so sq-al sq-mk sr-me sr-rs ss-za st-za sv-fi sv-se sw-ke sw-tz szl-pl ta-in ta-lk tg-tj th-th the-np tk-tm tl-ph tn-za tr-cy ts-za tt-ru ug-cn uk-ua unm-us ur-in ur-pk uz-uz ve-za vi-vn wa-be wae-ch wo-sn xh-za yi-us yo-ng yue-hk zh-cn zh-hk zh-sg zh-tw zu-za
IMAGE_LINGUAS="en-us de-de "
#IMAGE_LINGUAS = "en-us en-gb pt-br de-de"

# GLIBC_GENERATE_LOCALES var specifies which locales to be generated. empty or "all" means all locales
GLIBC_GENERATE_LOCALES="all"

DISTRO_FEATURES_append = " pam wifi ipv6 ipsec"

INIT_MANAGER = "sysvinit"

IMAGE_NAME = "${IMAGE_BASENAME}-${WANTED_ROOT_DEV}-${MACHINE}-${DATETIME}"
IMAGE_NAME[vardepsexclude] += "DATETIME"
IMAGE_LINK_NAME = "${IMAGE_BASENAME}-${WANTED_ROOT_DEV}-${MACHINE}"
IMAGE_PROTECT_ALGORITHMS ?= "size md5 rmd160 sha1"

#PREFERRED_PROVIDER_procps = "busybox"
PREFERRED_RPROVIDER_procps = "busybox"

require conf/distro/poky.conf

DISTRO = "updatable"
DISTROOVERRIDES_append = ":poky"
DISTRO_NAME = "Updatable Poky Based Linux"
DISTRO_VERSION = "1.0.0"
DISTRO_CODENAME = "rocko"
```

## conf/layer.conf
```bitbake
# We have a conf and classes directory, add to BBPATH
BBPATH .= ":${LAYERDIR}"

# We have a recipes-* directories, add to BBFILES
BBFILES += "${LAYERDIR}/recipes-*/*/*.bb \
            ${LAYERDIR}/recipes-*/*/*.bbappend"

BBFILE_COLLECTIONS += "jens-playground"
BBFILE_PATTERN_jens-playground = "^${LAYERDIR}/"
BBFILE_PRIORITY_jens-playground = "12"

FILESYSTEM_PERMS_TABLES = "files/multifs-perms.txt"

# This should only be incremented on significant changes that will
# cause compatibility issues with other layers
LAYERVERSION_jens-playground = "2"

LAYERDEPENDS_jens-playground = "core openembedded-layer cpan-layer"
LAYERSERIES_COMPAT_jens-playground = "sumo thud"
```

## conf/machine/include/updatable-container-default-spec.inc
```bitbake
# Updatable Image Container - specify images

UPDATABLE_BUNDLE_HASH_ALGORITHMS ?= "size md5 rmd160 sha1"
UPDATABLE_BUNDLE_SIGN_ALGORITHM  ?= "sha256"

UPDATABLE_BUNDLE_MANIFEST ??= "manifest"

UPDATABLE_BUNDLE_HOOKS ??= ""
UPDATABLE_BUNDLE_HOOKS_append = " cleandeploy cleanupdate cleanbundle clean_volatile check_app check_updater"
UPDATABLE_BUNDLE_HOOKS[trigger] ?= "postverify preupdate postupdate predeploy postdeploy onfinish finishdeploy finishupdate"

UPDATABLE_BUNDLE_HOOK_cleandeploy[type] = "inline"
UPDATABLE_BUNDLE_HOOK_cleandeploy[trigger] = "finishdeploy"
UPDATABLE_BUNDLE_HOOK_cleandeploy[code] = "if test "${INTERNAL_ROOT_DEV}" = "${WANTED_ROOT_DEV}"; then reboot; else umount ${MNT_BOOT} ${MNT_DATA}; fi"

UPDATABLE_BUNDLE_HOOK_cleanupdate[type] = "inline"
UPDATABLE_BUNDLE_HOOK_cleanupdate[trigger] = "finishupdate"
UPDATABLE_BUNDLE_HOOK_cleanupdate[code] = "logger "Requesting reboot"; reboot"

UPDATABLE_BUNDLE_HOOK_cleanbundle[type] = "inline"
UPDATABLE_BUNDLE_HOOK_cleanbundle[trigger] = "onfinish"
UPDATABLE_BUNDLE_HOOK_cleanbundle[code] = "if test -n "${UPDATE_APP}" -a -z "${UPDATE_UPDATER}"; then umount "${BUNDLE_CONTAINER}"; rm -rf $(dirname ${BUNDLE_FILE}); fi"

UPDATABLE_BUNDLE_HOOK_clean_volatile[type] = "inline"
UPDATABLE_BUNDLE_HOOK_clean_volatile[trigger] = "postupdate"
UPDATABLE_BUNDLE_HOOK_clean_volatile[code] = "logger "Force rebuild of volatiles.cache next boot"; rm -f /etc/volatile.cache"

UPDATABLE_BUNDLE_HOOK_check_app[type] = "inline"
UPDATABLE_BUNDLE_HOOK_check_app[trigger] = "predeploy preupdate"
UPDATABLE_BUNDLE_HOOK_check_app[code] = "if test $(mount | grep "on / type" | sed -e "s/ on.*//") != "${PARTDEV_APP}"; then export UPDATE_APP=Y; fi"

UPDATABLE_BUNDLE_HOOK_check_updater[type] = "inline"
UPDATABLE_BUNDLE_HOOK_check_updater[trigger] = "predeploy preupdate"
UPDATABLE_BUNDLE_HOOK_check_updater[code] = "if test $(mount | grep "on / type" | sed -e "s/ on.*//") != "${PARTDEV_UPDATER}"; then export UPDATE_UPDATER=Y; fi"

UPDATABLE_BUNDLE_IMAGES ?= "APP UPDATER"

UPDATABLE_IMAGE_APP     ?= "updatable-image-app${UPDATABLE_BUNDLE_DEVELOPER_IMAGE_EXTNAME}"
UPDATABLE_IMAGE_UPDATER ?= "updatable-image-core${UPDATABLE_BUNDLE_DEVELOPER_IMAGE_EXTNAME}"

UPDATABLE_BUNDLE_SLOTS  += "${UPDATABLE_BUNDLE_IMAGES}"

UPDATABLE_SLOT_APP            ?= "${UPDATABLE_IMAGE_APP}"
UPDATABLE_SLOT_APP[type]      ?= "image"
UPDATABLE_SLOT_APP[file]      ?= "${UPDATABLE_IMAGE_APP}-${WANTED_ROOT_DEV}-${MACHINE}.${IMAGE_FSTYPES}"
UPDATABLE_SLOT_APP[dest]      ?= "partition"
UPDATABLE_SLOT_APP[condition] ?= "test "${UPDATE_APP}" = Y"
UPDATABLE_SLOT_UPDATER            ?= "${UPDATABLE_IMAGE_UPDATER}"
UPDATABLE_SLOT_UPDATER[type]      ?= "image"
UPDATABLE_SLOT_UPDATER[file]      ?= "${UPDATABLE_IMAGE_UPDATER}-${WANTED_ROOT_DEV}-${MACHINE}.${IMAGE_FSTYPES}"
UPDATABLE_SLOT_UPDATER[dest]      ?= "partition"
UPDATABLE_SLOT_UPDATER[condition] ?= "test "${UPDATE_UPDATER}" = Y"

UPDATABLE_PARTITIONS            ?= "BOOT APP UPDATER DATA"
UPDATABLE_PARTITIONS[type]      ?= "msdos"
UPDATABLE_PARTITIONS[alignment] ?= "1M"

UPDATABLE_PARTITION_BOOT[type]       ?= "partition"
UPDATABLE_PARTITION_BOOT[size]       ?= "32M"
UPDATABLE_PARTITION_BOOT[filesystem] ?= "ext4"
UPDATABLE_PARTITION_BOOT[fs_create]  ?= "-L boot-${MACHINE} -I128"
UPDATABLE_PARTITION_BOOT[fs_tune]    ?= "-L boot-${MACHINE} -O discard,block_validity"
UPDATABLE_PARTITION_BOOT[src]        ?= "none"
UPDATABLE_PARTITION_BOOT[mountpoint] ?= "/boot"

UPDATABLE_PARTITION_APP[type]       ?= "partition"
UPDATABLE_PARTITION_APP[size]       ?= "512M"
UPDATABLE_PARTITION_APP[filesystem] ?= "squashfs"
UPDATABLE_PARTITION_APP[src]        ?= "slot"
UPDATABLE_PARTITION_APP[slot]       ?= "APP"
UPDATABLE_PARTITION_APP[onmount]    ?= "UPDATE_UPDATER=Y"

UPDATABLE_PARTITION_UPDATER[type]       ?= "partition"
UPDATABLE_PARTITION_UPDATER[size]       ?= "128M"
UPDATABLE_PARTITION_UPDATER[filesystem] ?= "squashfs"
UPDATABLE_PARTITION_UPDATER[src]        ?= "slot"
UPDATABLE_PARTITION_UPDATER[slot]       ?= "UPDATER"

UPDATABLE_PARTITION_DATA[type]       ?= "partition"
UPDATABLE_PARTITION_DATA[size]       ?= "-1"
UPDATABLE_PARTITION_DATA[filesystem] ?= "ext4"
UPDATABLE_PARTITION_DATA[fs_create]  ?= "-L data-${MACHINE}"
UPDATABLE_PARTITION_DATA[fs_tune]    ?= "-L data-${MACHINE} -O journal_data,discard,block_validity"
# layout by volatile
UPDATABLE_PARTITION_DATA[src]        ?= "none"
UPDATABLE_PARTITION_DATA[mountpoint] ?= "/data"
```
